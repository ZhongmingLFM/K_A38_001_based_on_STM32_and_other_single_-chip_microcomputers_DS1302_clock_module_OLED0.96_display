/************************************************************************************
//（店名“众明工作室”）淘宝链接: https://shop149406681.taobao.com/?spm=a1z10.1-c.0.0.64cb457fKzgKea 
//淘宝店内搜索关键词：K_A38_001
//  版 本 号   : v1.0
//  作    者   : 众明工作室
//  交流群 :			 1041406448（其它更多资料请关注公告）
//    CSDN  （基本参数，资源更新列表，所有接线说明）   :单片机代码搬运工(搜索关键词：K_A38_001)
//    BILIBILI（演示视频） :众明工作室(搜索关键词：K_A38_001)
//  生成日期   : 2021-6-21
//  最近修改   : 2021-11-21
//  功能描述   : DS1302块测试程序
//  测试条件   : STC89C52RC   晶振11.0592
接线
DS1302---------------------------------STC89C52RC
VCC------------------------------------5V
GND------------------------------------GND
CLK------------------------------------P1.4
DAT------------------------------------P1.2
RST------------------------------------P1.3

OLED0.96(IIC) -------------------------STC89C52RC
VCC------------------------------------5V
GND------------------------------------GND
SCL------------------------------------P1^1
SDA------------------------------------P1^0
*************************************************************************************/
#include "Uart.h"
uint8_t R_DatBuf[10]={0};
uint8_t T_DatBuf[10]={0};
void UartInit(void)
{
			TMOD = 0x20;   //定时器工作在定时器1的方式2
			PCON = 0x00;   //不倍频
			SCON = 0x50;	//串口工作在方式1，并且启动串行接收	
			TH1 = 0xFD;    //设置波特率 9600
			TL1 = 0xFD;
			//ET1 = 0;
			TR1 = 1;		//启动定时器1

			ES = 1;		//开串口中断
			EA = 1;		//开总中断	
}

void UartSend(uint8_t dat)
{
//    while (busy);
//    busy = 1;
    SBUF = dat;
		while(TI==0);	
	  TI=0;
}

void UartSendStr(uint8_t *p)
{
    while (*p!='\0')
    {
        UartSend(*p++);
    }
}
void RSINTR() interrupt 4 using 2
{
	
	if(TI==1) //发送中断	  
	{
		
	}

	if(RI==1)	 //接收中断		  
	{	
		
	}
}